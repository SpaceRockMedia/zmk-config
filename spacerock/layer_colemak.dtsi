ZMK_LAYER(base,
//╭──────╮╭─────────────┬─────────────┬─────────────┬─────────────┬─────────────╮╭──────╮╭──────╮╭─────────────┬─────────────┬─────────────┬─────────────┬─────────────╮ ╭──────╮
    X_LN    ________________________X_LEFT_ROW_________________________________    X_MLN   X_MRN   ________________________X_RIGHT_ROW________________________________     X_RN
//├──────┤├─────────────┼─────────────┼─────────────┼─────────────┼─────────────┤├──────┤├──────┤├─────────────┼─────────────┼─────────────┼─────────────┼─────────────┤ ├──────┤
    X_LT    &kp Q         &kp W         &kp F         &kp P         &kp B          X_MLT   X_MRT   &kp J         &kp L         &lt WIN U     &kp Y         &kp SEMI        X_RT
//├──────┤├─────────────┼─────────────┼─────────────┼─────────────┼─────────────┤├──────┤├──────┤├─────────────┼─────────────┼─────────────┼─────────────┼─────────────┤ ├──────┤
    X_LM    &hml LGUI A   &hml LALT R   &hml LCTRL S  &hml LSHFT T  &kp G          X_MLM   X_MRM   &kp M         &hmr RSHFT N  &hmr LCTRL E  &hmr LALT I   &hmr LGUI O     X_RM
//├──────┤├─────────────┼─────────────┼─────────────┼─────────────┼─────────────┤├──────┤├──────┤├─────────────┼─────────────┼─────────────┼─────────────┼─────────────┤ ├──────┤
    X_LB    &kp Z         &kp X         &kp C         &kp D         &kp V          X_MLB   X_MRB   &kp K         &kp H         &comma_morph  &dot_morph    &qexcl          X_RB
//├──────┤╰─────────────┼─────────────┴─────────────┼─────────────┼─────────────┤├──────┤├──────┤├─────────────┼─────────────┼─────────────┴───────────────────────────╯ ├──────┤
    X_LH                                              &lt_spc FUN 0 &smart_shft    X_MLH   X_MRH   &smart_shft   &lt NAV RET                                               X_RH
//╰──────╯                            ╰─────────────┴─────────────┴─────────────╯╰──────╯╰──────╯╰─────────────┴─────────────┴─────────────╯                             ╰──────╯
)
