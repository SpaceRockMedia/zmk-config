 /* source keypos definitions */
// #include <behaviors.dtsi>
#include <dt-bindings/zmk/keys.h>
// #include <dt-bindings/zmk/bt.h>
// #include <dt-bindings/zmk/ext_power.h>
// #include <dt-bindings/zmk/outputs.h>
// #include <dt-bindings/zmk/rgb.h>

#include "../lib/zmk-helpers/helper.h"

#include "spacerock.h"
#include "behaviors.dtsi"

//#include "rgb.dtsi"



// tap: right-shift | left-shift + tap: ]
// ZMK_BEHAVIOR(bclose, mod_morph,
//     bindings = <&kp RPAR>, <&kp RBKT>;
//     mods = <(MOD_LSFT)>;
// )

// // tap: left-shift | right-shift + tap: [
// ZMK_BEHAVIOR(bopen, mod_morph,
//     bindings = <&kp LPAR>, <&kp LBKT>;
//     mods = <(MOD_RSFT)>;
// )

//#include "combos.dtsi"
