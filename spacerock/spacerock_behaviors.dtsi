#include <behaviors.dtsi>
#include <dt-bindings/zmk/keys.h>
#include <dt-bindings/zmk/bt.h>
#include <dt-bindings/zmk/ext_power.h>
#include <dt-bindings/zmk/outputs.h>
#include <dt-bindings/zmk/rgb.h>

#include "../lib/zmk-helpers/helper.h"
#include "./behaviors/caps_word.dtsi"
#include "./behaviors/num_word.dtsi"
#include "./behaviors/swapper.dtsi"

//
// HOLD TAPs (&mt)
//
// ZMK_BEHAVIOR(some_mt, hold_tap,
//     bindings = <&kp>, <&kp>;
//     MT_CORE
// )





//
// Nav Word
//
// ZMK_BEHAVIOR(nav_dance, tap_dance,
//     tapping-term-ms = <200>;
//     bindings = <&nav_word>, <&sl NAV>;  // reverse this for sticky-num on single tap
// )
// ZMK_BEHAVIOR(smart_num, hold_tap,
//     flavor = "balanced";
//     tapping-term-ms = <200>;
//     quick-tap-ms = <QUICK_TAP_MS>;
//     bindings = <&mo>, <&nav_dance>;
// )
// // tap: num-word | double-tap: sticky num-layer | hold: num-layer
// #define SMART_NAV &smart_num NAV 0

// #define NAVS_LAYOUTS _______________________NAVS_TOP_______________________ _______________________NAVS_MID_______________________
// #define NAVS HOME END
// #define NAVS_MODS LSHFT RSHFT LCTRL RCTRL LALT RALT LGUI RGUI
// &nav_word {  // num-word, requires PR #1451
//     layers = <NAV>;
//     continue-list = <NAVS_LAYOUTS NAVS NAVS_MODS>;
// };
