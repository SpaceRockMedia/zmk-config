#include <behaviors.dtsi>
#include <dt-bindings/zmk/keys.h>

#include "../../lib/zmk-helpers/helper.h"

//
// Caps Word
// tap: sticky-shift | shift + tap/ double-tap: caps-word | hold: shift
ZMK_BEHAVIOR(smart_shft, mod_morph,
    bindings = <&sk LSHFT>, <&caps_word>;
    mods = <(MOD_LSFT)>;
)
SPACEROCK_MOD_SHIFT(smart_shift, &sk LSHFT, &caps_word)
&caps_word {  // mods deactivate caps-word, requires PR #1451
    /delete-property/ ignore-modifiers;
};
