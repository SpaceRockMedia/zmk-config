#include <behaviors.dtsi>
#include <dt-bindings/zmk/keys.h>

#include <behaviors/num_word.dtsi>
#include "../../lib/zmk-helpers/helper.h"

// these pressed will keep numword going
#define NUM_PERENS \
    KP_LEFT_PARENTHESIS KP_LPAR KP_RIGHT_PARENTHESIS KP_RPAR \
    LEFT_PARENTHESIS LPAR RIGHT_PARENTHESIS RPAR
#define NUM_EMDAS \
    KP_MULTIPLY KP_ASTERISK ASTERISK ASTRK STAR \
    KP_DIVIDE KP_SLASH SLASH FSLH \
    KP_PLUS PLUS \
    KP_MINUS KP_SUBTRACT MINUS
#define NUM_OPERATORS KP_DOT DOT KP_COMMA COMMA KP_EQUAL KP_EQUAL_AS400 EQUAL BSPC DEL UNDER

//#define ZMK_BEHAVIOR_CORE_space_word compatible = "zmk,behavior-space-word"; #binding-cells = <0>

&num_word {
  layers = <NAV>;
  continue-list = <NUM_PERENS NUM_EMDAS NUM_OPERATORS>;
}

ZMK_BEHAVIOR(space_word, num_word,
    layers = <NAV>;
    continue-list = <NUM_PERENS NUM_EMDAS NUM_OPERATORS>;
    ignore-numbers;
)

ZMK_BEHAVIOR(num_dance, tap_dance,
    tapping-term-ms = <200>;
    bindings = <&space_word>, <&sl NAV>;  // reverse this for sticky-num on single tap
)
ZMK_BEHAVIOR(smart_num, hold_tap,
    flavor = "balanced";
    tapping-term-ms = <200>;
    quick-tap-ms = <QUICK_TAP_MS>;
    bindings = <&mo>, <&num_dance>;
)
// tap: num-word | double-tap: sticky num-layer | hold: num-layer
#define SMART_NUM &smart_num NAV 0
