/*
 * Copyright (c) 2020 The ZMK Contributors
 *
 * SPDX-License-Identifier: MIT
 */

 #include <behaviors.dtsi>
 #include <dt-bindings/zmk/keys.h>
 #include <dt-bindings/zmk/bt.h>
 #include <dt-bindings/zmk/ext_power.h>
 #include <dt-bindings/zmk/outputs.h>
 #include <dt-bindings/zmk/mouse.h>

/*                              36 KEY MATRIX / LAYOUT MAPPING
   ╭────────────────────┬────────────────────╮
   │  0   1   2   3   4 │  5   6   7   8   9 │
   │ 10  11  12  13  14 │ 15  16  17  18  19 │
   │ 20  21  22  23  24 │ 25  26  27  28  29 │
   ╰───────╮ 30  31  32 │ 33  34  35 ╭───────╯
           ╰────────────┴────────────╯
  ╭─────────────────────┬─────────────────────╮
  │ LT4 LT3 LT2 LT1 LT0 │ RT0 RT1 RT2 RT3 RT4 │
  │ LM4 LM3 LM2 LM1 LM0 │ RM0 RM1 RM2 RM3 RM4 │
  │ LB4 LB3 LB2 LB1 LB0 │ RB0 RB1 RB2 RB3 RB4 │
  ╰───────╮ LH2 LH1 LH0 │ RH0 RH1 RH2 ╭───────╯
          ╰─────────────┴─────────────╯
*/
/* source key position labels */
// #include "zmk-helpers/include/zmk-helpers/key-labels/36.h"
#include "zmk-helpers/include/zmk-helpers/key-labels/36.h"

/* activate bluetooth */
#define CONFIG_WIRELESS 1

#define X_LH  SMART_NUM
#define X_RH  SMART_NUM

/* source the main keymap */
#include "../../../base.keymap"

ZMK_APPLY_MATRIX_TRANSFORM(default_transform)

//  / {
//      keymap {
//          compatible = "zmk,keymap";

//          sym_layer {
//              bindings = <
//      &kp EXCL     &kp AT       &kp HASH        &kp DLLR         &kp PRCNT                                   &kp CARET     &kp AMPS          &kp ASTRK     &kp UNDER   &kp EQUAL
//      &kp MINUS    &kp LBKT     &kp LBRC        &kp LPAR         &kp LT                                      &kp GT        &kp RPAR          &kp RBRC      &kp RBKT    &kp PLUS
//      &kp CAPS     &kp GRAVE    &kp LC(LS(TAB)) &kp LC(LG(LEFT)) &caps_word                                  &trans        &kp LC(LG(RIGHT)) &kp LC(TAB)   &trans      &kp BSLH
//                                                &trans           &kp RET       &kp DEL        &kp BSPC       &trans        &trans
//              >;
//          };

//          func_layer {
//              bindings = <
//      &bootloader  &kp LS(PG_UP) &kp LS(UP)   &kp LS(PG_DN) &trans                                      &kp C_PLAY_PAUSE &kp F7       &kp F8        &kp F9      &kp F10
//      &kp LS(HOME) &kp LS(LEFT)  &kp LS(DOWN) &kp LS(RIGHT) &kp LS(END)                                 &kp K_VOL_UP     &kp F4       &kp F5        &kp F6      &kp F11
//      &trans       &trans        &trans       &trans        &kp C_MUTE                                  &kp K_VOL_DN     &kp F1       &kp F2        &kp F3      &kp F12
//                                              &trans        &trans        &trans       &trans           &kp SPACE        &trans
//              >;
//          };

//          media_layer {
//              bindings = <
//      &trans       &trans        &trans       &trans        &trans                                     &trans             &bt BT_PRV        &bt BT_NXT         &sys_reset     &bootloader
//      &trans       &trans        &trans       &trans        &trans                                     &bt BT_CLR         &bt BT_SEL 0      &bt BT_SEL 1       &bt BT_SEL 2   &bt BT_SEL 3
//      &trans       &trans        &trans       &trans        &trans                                     &ext_power EP_TOG  &ext_power EP_ON  &ext_power EP_OFF  &out OUT_USB   &out OUT_BLE
//                                              &trans        &trans        &trans        &trans         &trans             &trans
//              >;
//          };

//          numlft_layer {
//              bindings = <
//      &mkp MCLK    &kp N7       &kp N8       &kp N9        &trans                                      &trans      &trans      &trans      &trans      &trans
//      &mkp LCLK    &kp N4       &kp N5       &kp N6        &trans                                      &trans      &trans      &trans      &trans      &trans
//      &mkp RCLK    &kp N1       &kp N2       &kp N3        &kp N0                                      &trans      &trans      &trans      &trans      &trans
//                                             &trans        &trans        &trans         &trans         &trans      &trans
//              >;
//          };

//          numrht_layer {
//             bindings = <
//                 &trans       &trans       &trans       &trans        &trans                                      &trans      &kp N7       &kp N8        &kp N9      &kp MINUS
//                 &trans       &trans       &trans       &trans        &trans                                      &trans      &kp N4       &kp N5        &kp N6      &kp PLUS
//                 &trans       &trans       &trans       &trans        &trans                                      &trans      &kp N1       &kp N2        &kp N3      &kp N0
//                                                     &trans        &trans        &trans         &trans         &trans      &trans
//             >;
//         };
//      };
//  };
