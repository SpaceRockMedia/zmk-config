/*
 * Copyright (c) 2020 The ZMK Contributors
 *
 * SPDX-License-Identifier: MIT
 */

/*
  ╭────────────────────────┬───────────────────────╮
  │  0   1   2   3   4   5 │  6   7   8   9 10  11 │
  │ 12  13  14  15  16  17 │ 18  19  20  21 22  23 │
  │ 24  25  26  27  28  29 │ 30  31  32  33 34  35 │
  ╰───────────╮ 36  37  38 │ 39 40  41 ╭───────────╯
              ╰────────────┴───────────╯
 ╭─────────────────────────┬─────────────────────────╮
 │ LT5 LT4 LT3 LT2 LT1 LT0 │ RT0 RT1 RT2 RT3 RT4 RT5 │
 │ LM5 LM4 LM3 LM2 LM1 LM0 │ RM0 RM1 RM2 RM3 RM4 RM5 │
 │ LB5 LB4 LB3 LB2 LB1 LB0 │ RB0 RB1 RB2 RB3 RB4 RB5 │
 ╰───────────╮ LH2 LH1 LH0 │ RH0 RH1 RH2 ╭───────────╯
             ╰─────────────┴─────────────╯
*/
/* source key position labels */
#include "../../../../../zmk-modules/zmk-helpers/include/zmk-helpers/key-labels/42.h"
//#include "ffkb_lite_v1.overlay"

/* activate bluetooth */
#define CONFIG_WIRELESS 1

/* map extra keys */
#define X_LT  &kp GRAVE
#define X_LM  &smart_mouse
#define X_LB  &kp LGUI
#define X_LH  SMART_NUM

#define X_RT  &kp BSPC
#define X_RM  &kp SQT
#define X_RB  &kp RGUI
#define X_RH  SMART_NUM

/* source the main keymap */
#include "../../../base.keymap"

ZMK_APPLY_MATRIX_TRANSFORM(ffkb_transform)



//         func_layer {
//             bindings = <
//     ___     &bootloader  &kp LS(PG_UP) &kp LS(UP)   &kp LS(PG_DN) ___                                      &kp C_PLAY_PAUSE &kp F7       &kp F8        &kp F9      &kp F10     ___
//     ___     &kp LS(HOME) &kp LS(LEFT)  &kp LS(DOWN) &kp LS(RIGHT) &kp LS(END)                                 &kp K_VOL_UP     &kp F4       &kp F5        &kp F6      &kp F11     ___
//     ___     ___       ___        ___       ___        &kp C_MUTE                                  &kp K_VOL_DN     &kp F1       &kp F2        &kp F3      &kp F12     ___
//                                                ________________________________       ___   &kp SPACE        ___
//             >;
//         };

//         sym_layer {
//             bindings = <
//     ___     &kp EXCL     &kp AT       &kp HASH        &kp DLLR         &kp PRCNT                                   &kp CARET     &kp AMPS          &kp ASTRK     &kp UNDER   &kp EQUAL   ___
//     ___     &kp MINUS    &kp LBKT     &kp LBRC        &kp LPAR         &kp LT                                      &kp GT        &kp RPAR          &kp RBRC      &kp RBKT    &kp PLUS    ___
//     ___     &kp CAPS     &kp GRAVE    &kp LC(LS(TAB)) &kp LC(LG(LEFT)) &caps_word                                  ___        &kp LC(LG(RIGHT)) &kp LC(TAB)   ___      &kp BSLH    ___
//                                           ___           &kp RET       &kp DEL        &kp BSPC       ___        ___
//             >;
//         };

//         media_layer {
//             bindings = <
//     ___     ___       ___        ___       ___        ___                                     ___             &bt BT_PRV        &bt BT_NXT         ___         ___          ___
//     ___     ___       ___        ___       ___        ___                                     &bt BT_CLR         &bt BT_SEL 0      &bt BT_SEL 1       &bt BT_SEL 2   &bt BT_SEL 3    ___
//     ___     ___       ___        ___       ___        ___                                     &ext_power EP_TOG  &ext_power EP_ON  &ext_power EP_OFF  &out OUT_USB   &out OUT_BLE    ___
//                                                        ___        ___        ___        ___         ___             ___
//             >;
//         };

//     };
// };
