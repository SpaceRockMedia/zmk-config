// Copyright 2023 SpaceRock Media LLC

// ██   ██ ██    ██ ██████  ██  █████      ██████  ███████ ██    ██ ██████
// ██  ██   ██  ██  ██   ██ ██ ██   ██     ██   ██ ██      ██    ██      ██
// █████     ████   ██████  ██ ███████     ██████  █████   ██    ██  █████
// ██  ██     ██    ██   ██ ██ ██   ██     ██   ██ ██       ██  ██       ██
// ██   ██    ██    ██   ██ ██ ██   ██     ██   ██ ███████   ████   ██████

/*
  ╭────────────────────────────────┬───────────────────────────────╮
  │  0   1   2   3   4   5         │          6   7   8   9 10  11 │
  │ 12  13  14  15  16  17         │         18  19  20  21 22  23 │
  │ 24  25  26  27  28  29  30  31 │ 32  33  34  35  36  37 38  39 │
  ╰───────────╮ 40  41  42  43  44 │ 45  46  47  48  49 ╭──────────╯
              ╰────────────────────┴────────────────────╯
 ╭─────────────────────────────────┬─────────────────────────────────╮
 │ LT5 LT4 LT3 LT2 LT1 LT0         │         RT0 RT1 RT2 RT3 RT4 RT5 │
 │ LM5 LM4 LM3 LM2 LM1 LM0         │         RM0 RM1 RM2 RM3 RM4 RM5 │
 │ LB5 LB4 LB3 LB2 LB1 LB0 LF1 LF0 │ RF0 RF1 RB0 RB1 RB2 RB3 RB4 RB5 │
 ╰───────────╮ LH4 LH3 LH2 LH1 LH0 │ RH0 RH1 RH2 RH3 RH4 ╭───────────╯
             ╰─────────────────────┴─────────────────────╯
*/

&led_strip {
    chain-length = <31>;
};

#include <behaviors.dtsi>
#include <dt-bindings/zmk/keys.h>
#include <dt-bindings/zmk/bt.h>
#include <dt-bindings/zmk/ext_power.h>
#include <dt-bindings/zmk/outputs.h>
#include <dt-bindings/zmk/rgb.h>

#include "modules/zmk-helpers/key-labels/kyria.h"
#include "modules/zmk-helpers/helper.h"

#include "../spacerock/spacerock.dtsi"

// / {
//     keymap {
//         compatible = "zmk,keymap";

//         default_layer {
//             bindings = <
//             &kp TAB   &kp Q &kp W &kp E &kp R &kp T                                               &kp Y    &kp U    &kp I     &kp O   &kp P    &kp BSLH
//             &kp ESC   &kp A &kp S &kp D &kp F &kp G                                               &kp H    &kp J    &kp K     &kp L   &kp SEMI &kp C_VOL_UP
//             &kp LCTL  &kp Z &kp X &kp C &kp V &kp B &bt BT_CLR &bt BT_SEL 0   &kp ESC   &kp RGUI  &kp N    &kp M    &kp COMMA &kp DOT &kp FSLH &kp C_VOL_DN
//                             XXX   &kp LGUI &kp LALT &kp SPACE  &kp LSHFT      &kp RCTRL &kp ENTER &kp RALT &kp RGUI XXX
//             >;

//             sensor-bindings = <&inc_dec_kp C_VOL_UP C_VOL_DN &inc_dec_kp PG_UP PG_DN>;
//         };
//     };
// };

#define BASE_LAYER_kyria(name, \
    _____________________LT______________________, _____________________RT______________________, \
    _____________________LM______________________, _____________________RM______________________, \
    _____________________LB______________________, _____________________RB______________________ \
) ZMK_LAYER(name, \
    &kp TAB    _____________________LT______________________                                    _____________________RT______________________ ___ \
    HT_CTL_ESC _____________________LM______________________                                    _____________________RM______________________ HT_CTL_SQT \
    &sk LALT   _____________________LB______________________ &kp HYP    XXX     XXX   &kp HYP   _____________________RB______________________ &sk RALT \
                         &sk LGUI &sk LCTRL HT_TOG_NAV HT_MEH_SPC &sk LSHFT     &sk RSHFT HT_MEH_ENT SMART_NUM &sk RCTRL &sk RGUI \
    , __ENC_VOL__ __ENC_VOL_REV__ \
)

BASE_LAYER_kyria(Game,
    ______________________QWERTY__LT______________________, ______________________QWERTY__RT______________________,
    ______________________QWERTY__LM______________________, ______________________QWERTY__RM______________________,
    ______________________QWERTY__LB______________________, ______________________QWERTY__RB______________________
)

BASE_LAYER_kyria(Colemak,
    ____________________COLEMAK_DH__LT____________________, ____________________COLEMAK_DH__RT____________________,
    ____________________COLEMAK_DH__LM____________________, ____________________COLEMAK_DH__RM____________________,
    ____________________COLEMAK_DH__LB____________________, ____________________COLEMAK_DH__RB____________________
)

#define HY_PG_UP &kp HY(PG_UP)
#define HY_PG_DN &kp HY(PG_DN)
ZMK_LAYER(Navi,
// ╭──────────┬──────────┬──────────┬──────────┬──────────┬──────────╮                                             ╭──────────┬──────────┬──────────┬──────────┬──────────┬──────────╮
    &kp PSCRN  _______________________NAVS_TOP_______________________                                               _______________________NUMS_TOP_______________________ ___
// ├──────────┼──────────┼──────────┼──────────┼──────────┼──────────┤                                             ├──────────┼──────────┼──────────┼──────────┼──────────┼──────────┤
    ___        _______________________NAVS_MID_______________________                                               _______________________NUMS_MID_______________________ ___
// ├──────────┼──────────┼──────────┼──────────┼──────────┼──────────┼──────────┼──────────╮ ╭──────────┼──────────┼──────────┼──────────┼──────────┼──────────┼──────────┼──────────┤
    ___        ___        ___        ___        ___        ___        ___        ___          ___        ___        _______________________NUMS_BOT_______________________ ___
// ╰──────────┴──────────┴──────────┴──────────┴──────────┴──────────╯──────────┴──────────╮ ╭──────────┴──────────╰──────────┴──────────┴──────────┴──────────┴──────────┴──────────╯
                                     ___        ___        &to COL &kp UNDER  ___          ___        ___        &to FUN  ___        ___
//                                  ╰──────────┴──────────┴──────────┴──────────┴──────────╯ ╰──────────┴──────────┴──────────┴──────────┴──────────╯
    , __ENC_VOL__ __ENC_VOL_REV__
)

ZMK_LAYER(Func,
// ╭──────────┬──────────┬──────────┬──────────┬──────────┬──────────╮                                             ╭──────────┬──────────┬──────────┬──────────┬──────────┬──────────╮
    ___        ___        ___        ___        ___        ___                                                      _______________________NUMS_TOP_______________________ ___
// ├──────────┼──────────┼──────────┼──────────┼──────────┼──────────┤                                             ├──────────┼──────────┼──────────┼──────────┼──────────┼──────────┤
    ___        ___        ___        ___        ___        ___                                                      _______________________NUMS_MID_______________________ ___
// ├──────────┼──────────┼──────────┼──────────┼──────────┼──────────┼──────────┼──────────╮ ╭──────────┼──────────┼──────────┼──────────┼──────────┼──────────┼──────────┼──────────┤
    ___        ___        ___        ___        ___        ___        ___        ___          ___        ___        _______________________NUMS_BOT_______________________ ___
// ╰──────────┴──────────┴──────────┴──────────┴──────────┴──────────╯──────────┴──────────╮ ╭──────────┴──────────╰──────────┴──────────┴──────────┴──────────┴──────────┴──────────╯
                                     ___        ___        &to COL &kp UNDER  ___          ___        ___        &to SYM ___        ___
//                                  ╰──────────┴──────────┴──────────┴──────────┴──────────╯ ╰──────────┴──────────┴──────────┴──────────┴──────────╯
    , __ENC_VOL__ __ENC_VOL_REV__
)

// ZMK_LAYER(Media,
// // ╭──────────┬──────────┬──────────┬──────────┬──────────┬──────────╮                                             ╭──────────┬──────────┬──────────┬──────────┬──────────┬──────────╮
//     ___        ___        ___        ___        ___        ___                                                      ___        ___        H_LIKE     VOL_UP     &kp C_PP ___
// // ├──────────┼──────────┼──────────┼──────────┼──────────┼──────────┤                                             ├──────────┼──────────┼──────────┼──────────┼──────────┼──────────┤
//     ___        ___        ___        ___        ___        ___                                                      ___        ___        &kp C_PREV &kp C_NEXT ___        ___
// // ├──────────┼──────────┼──────────┼──────────┼──────────┼──────────┼──────────┼──────────╮ ╭──────────┼──────────┼──────────┼──────────┼──────────┼──────────┼──────────┼──────────┤
//     ___        ___        ___        ___        ___        ___        ___        ___          ___        ___        ___        ___        H_SKIP     VOL_DN     &kp C_MUTE ___
// // ╰──────────┴──────────┴──────────┴──────────┴──────────┴──────────╯──────────┴──────────╮ ╭──────────┴──────────╰──────────┴──────────┴──────────┴──────────┴──────────┴──────────╯
//                                      ___        ___        &to COL ___        ___          ___        ___        ___        ___        ___
// //                                  ╰──────────┴──────────┴─────────aaqwwqdddd─┴──────────┴──────────╯ ╰──────────┴──────────┴──────────┴──────────┴──────────╯
//     , __ENC_VOL__ __ENC_VOL_REV__
// )

ZMK_LAYER(Conf,
// ╭──────────┬──────────┬──────────┬──────────┬──────────┬──────────╮                                             ╭──────────┬──────────┬──────────┬──────────┬──────────┬──────────╮
    ___        BT0        BT1        BT2        BT3        BT4                                                      ___        ___        ___        ___        ___        &bt BT_CLR
// ├──────────┼──────────┼──────────┼──────────┼──────────┼──────────┤                                             ├──────────┼──────────┼──────────┼──────────┼──────────┼──────────┤
    ___        ______________________BT_KEYS_UP______________________                                               ___        ______HOME_MODS__GAC_RIGHT______ ___        ___
// ├──────────┼──────────┼──────────┼──────────┼──────────┼──────────┼──────────┼──────────╮ ╭──────────┼──────────┼──────────┼──────────┼──────────┼──────────┼──────────┼──────────┤
    ___        ______________________BT_KEYS_DN______________________ ___        ___          ___        ___       ___        ___        ___        ___        ___        ___
// ╰──────────┴──────────┴──────────┴──────────┴──────────┴──────────╯──────────┴──────────╮ ╭──────────┴──────────╰──────────┴──────────┴──────────┴──────────┴──────────┴──────────╯
                                     ___        ___        &to COL ___        ___          ___        ___        &to NAV ___        ___
//                                  ╰──────────┴──────────┴──────────┴──────────┴──────────╯ ╰──────────┴──────────┴──────────┴──────────┴──────────╯
    , __ENC_VOL__ __ENC_VOL_REV__
)

// ZMK_LAYER(template,
// // ╭──────────┬──────────┬──────────┬──────────┬──────────┬──────────╮                                             ╭──────────┬──────────┬──────────┬──────────┬──────────┬──────────╮
//     ___        ___        ___        ___        ___        ___                                                      ___        ___        ___        ___        ___        ___
// // ├──────────┼──────────┼──────────┼──────────┼──────────┼──────────┤                                             ├──────────┼──────────┼──────────┼──────────┼──────────┼──────────┤
//     ___        ___        ___        ___        ___        ___                                                      ___        ___        ___        ___        ___        ___
// // ├──────────┼──────────┼──────────┼──────────┼──────────┼──────────┼──────────┼──────────╮ ╭──────────┼──────────┼──────────┼──────────┼──────────┼──────────┼──────────┼──────────┤
//     ___        ___        ___        ___        ___        ___        ___        ___          ___        ___        ___        ___        ___        ___        ___        ___
// // ╰──────────┴──────────┴──────────┴──────────┴──────────┴──────────╯──────────┴──────────╮ ╭──────────┴──────────╰──────────┴──────────┴──────────┴──────────┴──────────┴──────────╯
//                                      ___        ___        &to DEF ___        ___          ___        ___        ___        ___        ___
// //                                  ╰──────────┴──────────┴──────────┴──────────┴──────────╯ ╰──────────┴──────────┴──────────┴──────────┴──────────╯
//     , __ENC_VOL__ __ENC_VOL_REV__
// )
