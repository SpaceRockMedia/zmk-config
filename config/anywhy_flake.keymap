/*
 * Copyright (c) 2020 The ZMK Contributors
 *
 * SPDX-License-Identifier: MIT
 */

/*
  ╭────────────────────────┬────────────────────────╮
  │  0   1   2   3   4   5 │  6   7   8   9  10  11 │
  │ 12  13  14  15  16  17 │ 18  19  20  21  22  23 │
  │ 24  25  26  27  28  29 │ 30  31  32  33  34  35 │
  ╰───╮ 36  37  38  39  40 │ 41  42  43  44  45 ╭───╯
      ╰────────────────────┴────────────────────╯
 ╭─────────────────────────┬─────────────────────────╮
 │ LT5 LT4 LT3 LT2 LT1 LT0 │ RT0 RT1 RT2 RT3 RT4 RT5 │
 │ LM5 LM4 LM3 LM2 LM1 LM0 │ RM0 RM1 RM2 RM3 RM4 RM5 │
 │ LB5 LB4 LB3 LB2 LB1 LB0 │ RB0 RB1 RB2 RB3 RB4 RB5 │
 ╰───╮ LH4 LH3 LH2 LH1 LH0 │ RH0 RH1 RH2 RH3 RH4 ╭───╯
     ╰─────────────────────┴─────────────────────╯
*/
#include "zmk-helpers/helper.h"
/* source key position labels */
#include "zmk-helpers/key-labels/46.h"


#include "../spacerock/features/mouse.dtsi"

/* activate bluetooth */
#define CONFIG_WIRELESS 1

#define X_LT &lt SYS GRAVE
#define X_LM &kp Q
#define X_LB &kp LGUI

#define X_RT &lt SYS SQT
#define X_RM &kp P
#define X_RB &kp RGUI

#define thumb_base_left  &kp LPAR   &kp LBKT    &mt MEH BSPC  NUM_SPC  &kp LSHIFT
#define thumb_base_right &kp RSHIFT &lt NAV RET &mt MEH DEL   &kp RBKT &kp RPAR
#define thumb_nav_left   ___         ___        &kp MEH       &to 0    ___
#define thumb_nav_right  ___         ___        CANCEL        ___      ___
#define thumb_fun_left   ___         ___        &kp MEH       &to 0    ___
#define thumb_fun_right  ___         &kp C_MUTE &kp C_PP      ___      ___
#define thumb_num_left   ___         ___        &kp MEH       &to 0    ___
#define thumb_num_right  ___         ___        ___           ___      ___
#define thumb_sys_left   ___         ___        &kp MEH       &to 0    ___
#define thumb_sys_right  ___         ___        ___           ___      ___
#define thumb_pnt_left   ___         ___        &kp MEH       &to 0    ___
#define thumb_pnt_right  ___         &mkp LCLK  &mkp RCLK     ___      ___
#define thumb_win_left   ___         ___        &kp MEH       &to 0    ___
#define thumb_win_right  ___         ___        ___           ___      ___

#include <dt-bindings/zmk/matrix_transform.h>
#include <physical_layouts.dtsi>

/ { chosen { zmk,physical-layout = &medium_layout; }; };

#include "base.keymap"

// ZMK_LAYER(default_layer,
//     &lt SYS GRAVE &kp Q     &kp W         &kp E         &kp R         &lt FUN T            &lt FUN Y     &kp U         &lt WIN I     &kp O         &kp P           &lt SYS SQT
//     &kp ESC   &hml LCTRL A  &hml LSHFT S  &hml LALT D   &hml LGUI F   &kp G                &kp H         &hmr LGUI J   &hmr LALT K   &hmr RSHFT L  &hmr LCTRL SEMI &kp SQT
//     &kp LGUI  &kp Z         &kp X         &kp C         &kp V         &kp B                &kp N         &kp M         &comma_morph  &dot_morph    &qexcl          &kp RGUI
//               &kp LPAR      &kp LBKT      &mt MEH BSPC  DSPACE        &kp LSHIFT           &kp RSHIFT    &lt NAV RET   &mt MEH DEL       &kp RBKT      &kp RPAR
// )

// ZMK_LAYER(nav,
//     ___       &kp PG_UP     &kp ME(LEFT)  &kp UP        &kp ME(RIGHT) &kp ME(UP)           ___           ___           &kp LS(TAB)   &swapper      ___            ___
//     ___       &kp PG_DN     &kp LEFT      &kp DOWN      &kp RIGHT     &kp ME(DOWN)         ___           &sk LGUI      &sk LALT      &sk LSHFT      &sk LCTRL     ___
//     ___       &kp INS       &kp TAB       &kp LT        &kp GT        ___                  ___           ___           ___           ___           ___            ___
//               ___           ___           &kp MEH       &to 0         ___                  ___           ___           CANCEL       ___            ___
// )

// ZMK_LAYER(fun,
//     ___       &kp F12       &kp F7        &kp F8        &kp F9        ___                  ___           &kp C_PREV    &kp C_VOL_UP  &kp C_NEXT    &win_sleep     ___
//     ___       &hml LCTRL F11 &hml LSHFT F4 &hml LALT F5 &hml LGUI F6  ___                  ___           DSK_PREV      VOL_DOWN      DSK_NEXT      ___            ___
//     ___       &kp F10       &kp F1        &kp F2        &kp F3        ___                  PIN_APP       PIN_WIN       DSK_MGR       ___           ___            ___
//               ___          ___            &kp MEH       &to 0         ___                  ___           &kp C_MUTE    &kp C_PP      ___           ___
// )

// ZMK_LAYER(num,
//     ___       ___           ___           ___           ___           ___                  &kp EQUAL     &kp N7        &kp N8        &kp N9        &kp MINUS      ___
//     ___       &sk LGUI      &sk LALT      &sk LCTRL     &sk LSHFT     ___                  &kp ASTRK     &kp N4        &kp N5        &kp N6        &kp PLUS       ___
//     ___       ___           ___           ___           ___           ___                  &kp N0        &kp N1        &kp N2        &kp N3        &kp FSLH       ___
//               ___           ___           &kp MEH       &to 0         ___                  ___           ___           ___           ___           ___
// )

// ZMK_LAYER(sys,
//     ___       ____________________________BT_SEL_KEYS____________________________          ___           ___           ___           ___           ___            ___
//     ___       ___           ___           ___           ___           &bootloader          &bootloader   ___           ___           ___           ___            ___
//     &soft_off ___           ___           ___           ___           &sys_reset           &sys_reset    ___           ___           ___           ___            &soft_off
//               ___           ___           &kp MEH       &to 0         ___                  ___           ___           ___           ___           ___
// )

// ZMK_LAYER(pnt,
//     ___       ___           ___           ___           ___           ___                  ___           ___           ___           ___           ___            ___
//     ___       ___           ___           ___           ___           ___                  ___           ___           ___           ___           ___            ___
//     ___       ___           ___           ___           ___           ___                  ___           &mkp MB4      &mkp MCLK     &mkp MB5      ___            ___
//                ___          ___           &kp MEH       &to 0         ___                  ___           &mkp LCLK     &mkp RCLK     ___           ___
// )

// ZMK_LAYER(win,
//     ___       &bootloader   ___           &kp LG(UP)    ___           ___                  ___           ___           ___           ___           &bootloader    ___
//     ___       &sys_reset    &kp LG(LEFT)  &kp LG(DOWN)  &kp LG(RIGHT) ___                  ___           ___           ___           ___           &sys_reset     ___
//     ___       ___           ___           ___           ___           ___                  ___           ___           ___           ___           ___            ___
//               ___           ___           &kp MEH       &to 0         ___                  ___           ___           ___           ___           ___
// )

// /* vim: set ft=  tw=174: */
