// Copyright 2023 SpaceRock Media LLC

// ██   ██ ██    ██ ██████  ██  █████      ██████  ███████ ██    ██ ██████
// ██  ██   ██  ██  ██   ██ ██ ██   ██     ██   ██ ██      ██    ██      ██
// █████     ████   ██████  ██ ███████     ██████  █████   ██    ██  █████
// ██  ██     ██    ██   ██ ██ ██   ██     ██   ██ ██       ██  ██       ██
// ██   ██    ██    ██   ██ ██ ██   ██     ██   ██ ███████   ████   ██████

/*
  ╭────────────────────────────────┬───────────────────────────────╮
  │  0   1   2   3   4   5         │          6   7   8   9 10  11 │
  │ 12  13  14  15  16  17         │         18  19  20  21 22  23 │
  │ 24  25  26  27  28  29  30  31 │ 32  33  34  35  36  37 38  39 │
  ╰───────────╮ 40  41  42  43  44 │ 45  46  47  48  49 ╭──────────╯
              ╰────────────────────┴────────────────────╯
 ╭─────────────────────────────────┬─────────────────────────────────╮
 │ LT5 LT4 LT3 LT2 LT1 LT0         │         RT0 RT1 RT2 RT3 RT4 RT5 │
 │ LM5 LM4 LM3 LM2 LM1 LM0         │         RM0 RM1 RM2 RM3 RM4 RM5 │
 │ LB5 LB4 LB3 LB2 LB1 LB0 LF1 LF0 │ RF0 RF1 RB0 RB1 RB2 RB3 RB4 RB5 │
 ╰───────────╮ LH4 LH3 LH2 LH1 LH0 │ RH0 RH1 RH2 RH3 RH4 ╭───────────╯
             ╰─────────────────────┴─────────────────────╯
*/
#include <dt-bindings/zmk/mouse.h>

#include "zmk-helpers/helper.h"
#include "zmk-helpers/key-labels/kyria.h"


#define CONFIG_WIRELESS 1

/ {
    kscan: kscan {
        wakeup-source;
    };
};

#define X_LT  ___
#define X_LM  ___
#define X_LB  ___

#define X_RT  ___
#define X_RM  ___
#define X_RB  ___

// uppper thumbs
#define X_MLB ___ ___
#define X_MRB ___ ___

#define thumb_base_left  &kp LPAR   &kp LBKT    &mt MEH BSPC  NUM_SPC  &kp LSHIFT
#define thumb_base_right &kp RSHIFT NAV_ENT     &mt MEH DEL   &kp RBKT &kp RPAR
#define thumb_nav_left   ___         ___        &kp MEH       &to 0    ___
#define thumb_nav_right  ___         ___        CANCEL        ___      ___
#define thumb_fun_left   ___         ___        &kp MEH       &to 0    ___
#define thumb_fun_right  ___         &kp C_MUTE &kp C_PP      ___      ___
#define thumb_num_left   ___         ___        &kp MEH       &to 0    ___
#define thumb_num_right  ___         ___        ___           ___      ___
#define thumb_sys_left   ___         ___        &kp MEH       &to 0    ___
#define thumb_sys_right  ___         ___        ___           ___      ___
#define thumb_pnt_left   ___         ___        &kp MEH       &to 0    ___
#define thumb_pnt_right  ___         &mkp LCLK  &mkp RCLK     ___      ___
#define thumb_win_left   ___         ___        &kp MEH       &to 0    ___
#define thumb_win_right  ___         ___        ___           ___      ___

// #define X_SENSORS_BASE , &inc_dec_kp C_VOL_UP C_VOL_DN &inc_dec_kp XXX XXX
// #define X_SENSORS_NAV  , &inc_dec_kp C_VOL_UP C_VOL_DN &inc_dec_kp XXX XXX
// #define X_SENSORS_FUN  , &inc_dec_kp C_VOL_UP C_VOL_DN &inc_dec_kp XXX XXX
// #define X_SENSORS_NUM  , &inc_dec_kp C_VOL_UP C_VOL_DN &inc_dec_kp XXX XXX
// #define X_SENSORS_SYS  , &inc_dec_kp C_VOL_UP C_VOL_DN &inc_dec_kp XXX XXX
// #define X_SENSORS_PNT  , &inc_dec_kp C_VOL_UP C_VOL_DN &inc_dec_kp XXX XXX
// #define X_SENSORS_WIN  , &inc_dec_kp C_VOL_UP C_VOL_DN &inc_dec_kp XXX XXX

#include "base.keymap"

ZMK_APPLY_MATRIX_TRANSFORM(default_transform)

/* &sk LGUI &sk LCTRL HT_TOG_NAV HT_MEH_SPC &sk LSHFT     &sk RSHFT HT_MEH_ENT SMART_NUM &sk RCTRL &sk RGUI */
