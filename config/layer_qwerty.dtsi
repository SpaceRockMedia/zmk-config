ZMK_LAYER(base,
//╭──────╮╭─────────────┬─────────────┬─────────────┬─────────────┬─────────────╮╭──────╮╭──────╮╭─────────────┬─────────────┬─────────────┬─────────────┬─────────────╮╭──────╮
    X_LN    ________________________X_LEFT_ROW_________________________________    X_MLN   X_MRN   ________________________X_RIGHT_ROW________________________________    X_RN
//├──────┤├─────────────┼─────────────┼─────────────┼─────────────┼─────────────┤├──────┤├──────┤├─────────────┼─────────────┼─────────────┼─────────────┼─────────────┤├──────┤
    X_LT    &kp Q         &kp W         &kp E         &kp R         &lt FUN T      X_MLT   X_MRT   &lt FUN Y     &kp U         &lt WIN I     &kp O         &kp P          X_RT
//├──────┤├─────────────┼─────────────┼─────────────┼─────────────┼─────────────┤├──────┤├──────┤├─────────────┼─────────────┼─────────────┼─────────────┼─────────────┤├──────┤
    X_LM    &hml LCTRL A  &hml LSHFT S  &hml LALT D   &hml LGUI F   &kp G          X_MLM   X_MRM   &kp H         &hmr LGUI J   &hmr LALT K   &hmr RSHFT L  &hmr LCTRL SEMI X_RM
//├──────┤├─────────────┼─────────────┼─────────────┼─────────────┼─────────────┤├──────┤├──────┤├─────────────┼─────────────┼─────────────┼─────────────┼─────────────┤├──────┤
    X_LB    &kp Z         &kp X         &kp C         &kp V         &kp B          X_MLB   X_MRB   &kp N         &kp M         &comma_morph  &dot_morph    &qexcl         X_RB
//├──────┤╰─────────────┼─────────────┴─────────────┼─────────────┼─────────────┤├──────┤├──────┤├─────────────┼─────────────┼─────────────┴───────────────────────────╯├──────┤
    X_LH                                              DSPACE        LCADET         X_MLH   X_MRH   RCADET        &lt NAV RET                                              X_RH
//╰──────╯                                          ╰─────────────┴─────────────╯╰──────╯╰──────╯╰─────────────┴─────────────╯                                          ╰──────╯
, X_SENSORS_BASE)
