//
// Bluetooth
//
#define BT0 &bt BT_SEL 0
#define BT1 &bt BT_SEL 1
#define BT2 &bt BT_SEL 2
#define BT3 &bt BT_SEL 3
#define BT4 &bt BT_SEL 4


#if CONFIG_WIRELESS
    #include <dt-bindings/zmk/bt.h>
    #define ____________________________BT_SEL_KEYS____________________________ BT0 BT1 BT2 BT3 &bt BT_CLR
#else
    #define ____________________________BT_SEL_KEYS____________________________ &trans &trans &trans &trans &trans
#endif
