#include <behaviors.dtsi>
#include <dt-bindings/zmk/keys.h>
#include <dt-bindings/zmk/ext_power.h>
#include <dt-bindings/zmk/outputs.h>
#include <dt-bindings/zmk/rgb.h>

// #include "../../../zmk-modules/zmk-helpers/include/zmk-helpers/helper.h"

SPACEROCK_MOD_SHIFT(u_rgb_tog, &rgb_ug RGB_TOG, &rgb_ug RGB_OFF)
SPACEROCK_MOD_SHIFT(u_rgb_eff, &rgb_ug RGB_EFF, &rgb_ug RGB_EFR)
SPACEROCK_MOD_SHIFT(u_rgb_hue, &rgb_ug RGB_HUI, &rgb_ug RGB_HUD)
SPACEROCK_MOD_SHIFT(u_rgb_sat, &rgb_ug RGB_SAI, &rgb_ug RGB_SAD)
SPACEROCK_MOD_SHIFT(u_rgb_lev, &rgb_ug RGB_BRI, &rgb_ug RGB_BRD)

//
// bluetooth
//
#define ______________________BT_KEYS_UP______________________ &rgb_ug RGB_TOG &rgb_ug RGB_EFF &rgb_ug RGB_HUI &rgb_ug RGB_SAI &rgb_ug RGB_BRI
#define ______________________BT_KEYS_DN______________________ &rgb_ug RGB_OFF &rgb_ug RGB_EFR &rgb_ug RGB_HUD &rgb_ug RGB_SAD &rgb_ug RGB_BRD
