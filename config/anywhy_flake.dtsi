#include <dt-bindings/zmk/matrix_transform.h>
#include <physical_layouts.dtsi>

/ {
    chosen {
        zmk,physical-layout = &medium_layout;
    };

    default_transform: <&medium_transform>;
};

// &medium_layout {
//     transform = <&medium_transform>;
// };
