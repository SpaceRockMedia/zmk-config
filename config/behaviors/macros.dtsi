#include "../../../zmk-modules/zmk-helpers/include/zmk-helpers/helper.h"
// Windows sleep key
ZMK_BEHAVIOR(win_sleep, macro,
    wait-ms = <100>;
    tap-ms = <5>;
    bindings = <&kp LG(X) &kp U &kp S>;
)
