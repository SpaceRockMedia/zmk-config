// #include <dt-bindings/zmk/keys.h>
// #include <dt-bindings/zmk/outputs.h>

// these defaulted to 75
#define QUICK_TAP_MS 175
#define GLOBAL_QUICK_TAP_MS 175

#include "mod_tap.dtsi"
#include "hold_tap.dtsi"
#include "sticky_keys.dtsi"
#include "sticky_layers.dtsi"
#include "layer_taps.dtsi"
#include "mod_morph.dtsi"
#include "macros.dtsi"





//
// Hold Taps
//
#define MAKE_HOLD_TAP(NAME, HOLD, TAP) \
  ZMK_BEHAVIOR(NAME, hold_tap, \
        require-prior-idle-ms = <GLOBAL_QUICK_TAP_MS>; \
        bindings = <HOLD>, <TAP>; \
        hold-trigger-on-release; \
        MT_CORE \
  )

MAKE_HOLD_TAP(hold_tap_ctl_esc, &kp, &kp)
#define HT_CTL_ESC &hold_tap_ctl_esc LCTRL ESC

MAKE_HOLD_TAP(hold_tap_ctl_quote, &kp, &kp)
#define HT_CTL_SQT &hold_tap_ctl_quote RCTRL SQT

MAKE_HOLD_TAP(hold_tap_meh_spc, &kp, &kp)
#define HT_MEH_SPC &hold_tap_meh_spc MEH SPACE

MAKE_HOLD_TAP(hold_tap_meh_ent, &kp, &kp)
#define HT_MEH_ENT &hold_tap_meh_ent MEH ENTER

MAKE_HOLD_TAP(hold_tap_tog_nav, &mo, &to)
#define HT_TOG_NAV &hold_tap_tog_nav NAV NAV

MAKE_HOLD_TAP(hold_tap_tog_num, &mo, &to)
#define HT_TOG_NUM &hold_tap_tog_num NUM NUM

MAKE_HOLD_TAP(hold_tap_ctl_def, &kp, &to)
#define HT_CTL_DEF &hold_tap_ctl_def LCTRL DEF

MAKE_HOLD_TAP(hold_tap_ctl_gam, &kp, &to)
#define HT_CTL_GAM &hold_tap_ctl_gam LCTRL COL
