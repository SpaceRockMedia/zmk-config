/*
 * Copyright (c) 2020 The ZMK Contributors
 *
 * SPDX-License-Identifier: MIT
 */

/*
  ╭────────────────────────┬───────────────────────╮
  │  0   1   2   3   4   5 │  6   7   8   9 10  11 │
  │ 12  13  14  15  16  17 │ 18  19  20  21 22  23 │
  │ 24  25  26  27  28  29 │ 30  31  32  33 34  35 │
  ╰───────────╮ 36  37  38 │ 39 40  41 ╭───────────╯
              ╰────────────┴───────────╯
 ╭─────────────────────────┬─────────────────────────╮
 │ LT5 LT4 LT3 LT2 LT1 LT0 │ RT0 RT1 RT2 RT3 RT4 RT5 │
 │ LM5 LM4 LM3 LM2 LM1 LM0 │ RM0 RM1 RM2 RM3 RM4 RM5 │
 │ LB5 LB4 LB3 LB2 LB1 LB0 │ RB0 RB1 RB2 RB3 RB4 RB5 │
 ╰───────────╮ LH2 LH1 LH0 │ RH0 RH1 RH2 ╭───────────╯
             ╰─────────────┴─────────────╯
*/
#include "zmk-helpers/helper.h"
/* source key position labels */
#include "zmk-helpers/key-labels/44.h"

#include "../spacerock/features/mouse.dtsi"

/* activate bluetooth */
#define CONFIG_WIRELESS 1

/* map extra keys */
#define X_LT &lt SYS GRAVE
#define X_LM &kp Q
#define X_LB &kp LGUI
#define X_LH &kp C_MUTE

#define X_RT &lt SYS SQT
#define X_RM &kp P
#define X_RB &kp RGUI
#define X_RH &kp C_PP

#define thumb_base_left  &mt MEH BSPC  NUM_SPC  &kp LSHIFT
#define thumb_base_right &kp RSHIFT &lt NAV RET &mt MEH DEL
#define thumb_nav_left   &kp MEH     &to 0       ___
#define thumb_nav_right  ___         ___         CANCEL
#define thumb_fun_left   &kp MEH     &to 0       ___
#define thumb_fun_right  ___         &kp C_MUTE  &kp C_PP
#define thumb_num_left   &kp MEH     &to 0       ___
#define thumb_num_right  ___         ___         ___
#define thumb_sys_left   &kp MEH     &to 0       ___
#define thumb_sys_right  ___         ___         ___
#define thumb_pnt_left   &kp MEH     &to 0       ___
#define thumb_pnt_right  ___         &mkp LCLK   &mkp RCLK
#define thumb_win_left   &kp MEH     &to 0       ___
#define thumb_win_right  ___         ___         ___

#define X_SENSORS_BASE , &inc_dec_kp C_VOLUME_UP C_VOLUME_DOWN &inc_dec_kp K_SCROLL_UP K_SCROLL_DOWN
#define X_SENSORS_NAV  , &inc_dec_kp ___         ___           &inc_dec_kp ___         ___
#define X_SENSORS_FUN  , &inc_dec_kp ___         ___           &inc_dec_kp ___         ___
#define X_SENSORS_NUM  , &inc_dec_kp ___         ___           &inc_dec_kp ___         ___
#define X_SENSORS_SYS  , &inc_dec_kp ___         ___           &inc_dec_kp ___         ___
#define X_SENSORS_PNT  , &inc_dec_kp ___         ___           &inc_dec_kp ___         ___
#define X_SENSORS_WIN  , &inc_dec_kp ___         ___           &inc_dec_kp ___         ___

/* source the main keymap */
#include "base.keymap"

ZMK_APPLY_MATRIX_TRANSFORM(default_transform)
