/*
 * Copyright (c) 2020 The ZMK Contributors
 *
 * SPDX-License-Identifier: MIT
 */

/*                                      48 KEY MATRIX / LAYOUT MAPPING

  ╭────────────────────────────╮       ╭────────────────────────────╮
  │  0   1   2   3   4   5  6  │       │  7   8   9  10  11  12  13 │
  │ 14  15  16  17  18  19  20 │       │ 21  22  23  24  25  26  27 │
  │ 28  29  30  31  32  33  34 │       │ 35  36  37  38  39  40  41 │
  │ 42  43  44  45  46  47  48 ╰───┬───╯ 49  50  51  52  53  54  55 │
  ╰───────╮ 56  57  58  59  60  61 │ 62  63  64  65  66  67 ╭───────╯
          ╰────────────────────────┴────────────────────────╯
 ╭──────────────────────────────╮       ╭──────────────────────────────╮
 │ LN5 LN4 LN3 LN2 LN1 LN0 MLN0 │       │ MRN0 RN0 RN1 RN2 RN3 RN4 RN5 │
 │ LT5 LT4 LT3 LT2 LT1 LT0 MLT0 │       │ MRT0 RT0 RT1 RT2 RT3 RT4 RT5 │
 │ LM5 LM4 LM3 LM2 LM1 LM0 MLM0 │       │ MRM0 RM0 RM1 RM2 RM3 RM4 RM5 │
 │ LB5 LB4 LB3 LB2 LB1 LB0 MLB0 ╰───┬───╯ MRB0 RB0 RB1 RB2 RB3 RB4 RB5 │
 ╰───────╮ LH4 LH3 LH2 LH1 LH0  LP0 │ RP0 RH0 RH1  RH2 RH3 RH4 ╭───────╯
         ╰──────────────────────────┴──────────────────────────╯
*/

#include <behaviors.dtsi>
#include <dt-bindings/zmk/keys.h>
#include <dt-bindings/zmk/rgb.h>
#include <dt-bindings/zmk/outputs.h>
#include <zephyr/dt-bindings/pwm/pwm.h>
#include <dt-bindings/zmk/mouse.h>

#include "zmk-helpers/helper.h"
#include "zmk-helpers/key-labels/68.h"

#define X_LN  &kp ESC
#define X_LT  &kp GRAVE
#define X_LM  ___
#define X_LB  &kp LGUI
// #define X_LH  SMART_NUM ___ ___

#define X_MLN &kp N6
#define X_MLT ___
#define X_MLM ___
#define X_MLB ___
#define X_MLH ___

#define X_MRN &kp N7
#define X_MRT ___
#define X_MRM ___
#define X_MRB ___
#define X_MRH ___

#define X_RN  &kp DEL
#define X_RT  &kp BSPC
#define X_RM  &kp SQT
#define X_RB  &kp RGUI
// #define X_RH  ___ ___ SMART_NUM

#define thumb_base_left  &kp LPAR   &kp LBKT    &mt MEH BSPC  DSPACE   &kp LSHIFT
#define thumb_base_right &kp RSHIFT &lt NAV RET &mt MEH DEL   &kp RBKT &kp RPAR
#define thumb_nav_left   ___         ___        &kp MEH       &to 0    ___
#define thumb_nav_right  ___         ___        CANCEL        ___      ___
#define thumb_fun_left   ___         ___        &kp MEH       &to 0    ___
#define thumb_fun_right  ___         &kp C_MUTE &kp C_PP      ___      ___
#define thumb_num_left   ___         ___        &kp MEH       &to 0    ___
#define thumb_num_right  ___         ___        ___           ___      ___
#define thumb_sys_left   ___         ___        &kp MEH       &to 0    ___
#define thumb_sys_right  ___         ___        ___           ___      ___
#define thumb_pnt_left   ___         ___        &kp MEH       &to 0    ___
#define thumb_pnt_right  ___         &mkp LCLK  &mkp RCLK     ___      ___
#define thumb_win_left   ___         ___        &kp MEH       &to 0    ___
#define thumb_win_right  ___         ___        ___           ___      ___

#define ________________________X_LEFT_ROW_________________________________ __X_LEFT_NUM_ROW__
#define ________________________X_RIGHT_ROW________________________________ __X_RIGHT_NUM_ROW__

#define ________________________X_LEFT_NAV_________________________________ ___ ___ ___ ___ ___
#define ________________________X_RIGHT_NAV________________________________ ___ ___ ___ ___ ___

#define ________________________X_LEFT_FUN_________________________________ ___ ___ ___ ___ ___
#define ________________________X_RIGHT_FUN________________________________ ___ ___ ___ ___ ___

#define ________________________X_LEFT_NUM_________________________________ ___ ___ ___ ___ ___
#define ________________________X_RIGHT_NUM________________________________ ___ ___ ___ ___ ___

#define ________________________X_LEFT_SYS_________________________________ ___ ___ ___ ___ ___
#define ________________________X_RIGHT_SYS________________________________ ___ ___ ___ ___ ___

#define ________________________X_LEFT_PNT_________________________________ ___ ___ ___ ___ ___
#define ________________________X_RIGHT_PNT________________________________ ___ ___ ___ ___ ___

#define ________________________X_LEFT_WIN_________________________________ ___ ___ ___ ___ ___
#define ________________________X_RIGHT_WIN________________________________ ___ ___ ___ ___ ___

#define X_SENSORS_BASE , &inc_dec_kp C_VOLUME_UP C_VOLUME_DOWN &inc_dec_kp C_VOLUME_UP C_VOLUME_DOWN
#define X_SENSORS_NAV  , &inc_dec_kp C_VOLUME_UP C_VOLUME_DOWN &inc_dec_kp C_VOLUME_UP C_VOLUME_DOWN
#define X_SENSORS_FUN  , &inc_dec_kp C_VOLUME_UP C_VOLUME_DOWN &inc_dec_kp C_VOLUME_UP C_VOLUME_DOWN
#define X_SENSORS_NUM  , &inc_dec_kp C_VOLUME_UP C_VOLUME_DOWN &inc_dec_kp C_VOLUME_UP C_VOLUME_DOWN
#define X_SENSORS_SYS  , &inc_dec_kp C_VOLUME_UP C_VOLUME_DOWN &inc_dec_kp C_VOLUME_UP C_VOLUME_DOWN
#define X_SENSORS_PNT  , &inc_dec_kp C_VOLUME_UP C_VOLUME_DOWN &inc_dec_kp C_VOLUME_UP C_VOLUME_DOWN
#define X_SENSORS_WIN  , &inc_dec_kp C_VOLUME_UP C_VOLUME_DOWN &inc_dec_kp C_VOLUME_UP C_VOLUME_DOWN

// &caps_word {
//     continue-list = <UNDERSCORE MINUS>;
// };

// / {
//     sensors {
//         compatible = "zmk,keymap-sensors";
//         sensors = <&encoder_1 &encoder_2>;
//         triggers-per-rotation = <20>;
//     };
// };

// / {
//     macros {
//         u_kvm_switch: u_kvm_switch {
//             compatible = "zmk,behavior-macro";
//             #binding-cells = <0>;
//             bindings
//                 = <&macro_press &kp TAB>
//                 , <&macro_wait_time 200>
//                 , <&macro_tap &kp RIGHT>
//                 , <&macro_wait_time 200>
//                 , <&macro_release &kp TAB>
//                 ;
//         };
//     };
// };

/* source the main keymap */
#include "base.keymap"

ZMK_APPLY_MATRIX_TRANSFORM(default_transform)

    // behaviors {
    //     // for audio buzzer
    //     tone: tone {
    //         compatible = "chiptuner,behavior-tone";
    //         #binding-cells = <1>;
    //         pwms = <&pwm 2 PWM_USEC(20) PWM_POLARITY_NORMAL>;
    //     };
    // };
