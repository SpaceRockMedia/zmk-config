#include <behaviors.dtsi>
#include <dt-bindings/zmk/keys.h>

#include "modules/zmk-helpers/helper.h"

//
// Caps Word
// tap: sticky-shift | shift + tap/ double-tap: caps-word | hold: shift
ZMK_MOD_MORPH(smart_shft,
    bindings = <&sk LSHFT>, <&caps_word>;
    mods = <(MOD_LSFT)>;
)
&caps_word {  // mods deactivate caps-word, requires PR #1451
    /delete-property/ ignore-modifiers;
};
