#include <behaviors.dtsi>
#include <dt-bindings/zmk/keys.h>

#include "modules/zmk-helpers/helper.h"

// Alt+Tab swapper, requires PR #1366
ZMK_TRI_STATE(swapper,
    bindings = <&kt LALT>, <&kp TAB>, <&kt LALT>;
    ignored-key-positions = <LT2>;
)
