#include "../../../zmk-modules/zmk-helpers/include/zmk-helpers/helper.h"
// tap: space | shift + tap: dot -> space -> sticky shift | hold: activate layer
#define DSPACE &lt NUM SPACE
// ZMK_HOLD_TAP(lt_spc,
//     bindings = <&mo>, <&spc_morph>;
// )
SIMPLE_MORPH(spc_morph, SFT, &kp SPACE, &dot_spc)
ZMK_BEHAVIOR(dot_spc, macro,
    wait-ms = <0>;
    tap-ms = <5>;
    bindings = <&kp DOT &kp SPACE &sk LSHFT>;
)
