## boards/shields/adept/Kconfig.defconfig
```kconfig
if SHIELD_ADEPT

config ZMK_KEYBOARD_NAME
    default "adept"

endif

config SPI
	default y
```

## boards/shields/kyria/Kconfig.shield
```kconfig
# No whitespace after the comma or in the keyboard name!
config SHIELD_KYRIA_DONGLE
    def_bool $(shields_list_contains,kyria_dongle)

config SHIELD_KYRIA
    bool

config SHIELD_KYRIA_LEFT
    def_bool $(shields_list_contains,kyria_left)
    select SHIELD_KYRIA

config SHIELD_KYRIA_RIGHT
    def_bool $(shields_list_contains,kyria_right)
    select SHIELD_KYRIA

config SHIELD_KYRIA_REV2_LEFT
    def_bool $(shields_list_contains,kyria_rev2_left)
    select SHIELD_KYRIA

config SHIELD_KYRIA_REV2_RIGHT
    def_bool $(shields_list_contains,kyria_rev2_right)
    select SHIELD_KYRIA

config SHIELD_KYRIA_REV3_LEFT
    def_bool $(shields_list_contains,kyria_rev3_left)
    select SHIELD_KYRIA

config SHIELD_KYRIA_REV3_RIGHT
    def_bool $(shields_list_contains,kyria_rev3_right)
    select SHIELD_KYRIA
```

## config/west.yml
```yaml
manifest:
  remotes:
    - name: zmkfirmware
      url-base: https://github.com/zmkfirmware
    - name: spacerockmedia
      url-base: https://github.com/spacerockmedia
    - name: urob
      url-base: https://github.com/urob
    - name: sadekbaroudi
      url-base: https://github.com/sadekbaroudi
    - name: petejohanson
      url-base: https://github.com/petejohanson
    - name: dhruvinsh
      url-base: https://github.com/dhruvinsh
    - name: grassfedreeve
      url-base: https://github.com/grassfedreeve
    - name: badjeff
      url-base: https://github.com/badjeff
    - name: anywhy-io
      url-base: https://github.com/anywhy-io
    - name: carrefinho
      url-base: https://github.com/carrefinho
    - name: inorichi
      url-base: https://github.com/inorichi
  projects:
    - name: zmk
      remote: spacerockmedia
      revision: main
      import: app/west.yml

    # - name: cirque-input-module
    #   remote: petejohanson
    #   revision: main

    - name: prospector-zmk-module
      remote: carrefinho
      revision: main

    - name: zmk-fingerpunch-keyboards
      remote: sadekbaroudi
      revision: main
      import: config/deps.yml
    - name: zmk-fingerpunch-vik
      remote: sadekbaroudi
      revision: main
      import: config/deps.yml
    - name: zmk-fingerpunch-controllers
      remote: sadekbaroudi
      revision: main
      import: config/deps.yml

    - name: zmk-helpers
      remote: spacerockmedia
      revision: main

    - name: zmk-auto-layer
      remote: urob
      revision: main

    - name: zmk-num-word
      remote: dhruvinsh
      revision: main

    - name: zmk-leader-key
      remote: urob
      revision: v0.1 # Set to same version as ZMK.

    - name: zmk-keyboards-adept
      remote: grassfedreeve
      revision: main
    - name: zmk-pmw3610-driver
      remote: badjeff
      revision: main

    # - name: zmk-pmw3610-driver
    #   remote: inorichi
    #   revision: main

    - name: flake-zmk-module
      remote: anywhy-io
      revision: main
    # https://github.com/dhruvinsh/zmk-tri-state
    # - name: zmk-tri-state
    #   remote: dhruvinsh
    #   revision: main
  self:
    path: config
```
